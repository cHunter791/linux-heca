## drivers/heca/Kconfig
```kconfig
config HECA
	tristate "HECA"
	depends on NUMA && INFINIBAND && INFINIBAND_ADDR_TRANS && INET && MMU_NOTIFIER && MMU
	default m
	help
	  Enable HECA - allow sharing of memory of processes  accross multiple physical servers

config HECA_DEBUG
	bool "HECA_DEBUG"
	depends on HECA
	default n
	help
		HECA_DEBUG provides debug functionality for HECA 
		
config HECA_VERBOSE_PRINTK
	bool "HECA_VERBOSE_PRINTK"
	depends on HECA
	default n
	help
		HECA_VERBOSE_PRINTK provide verbose functionality 	
```
